## src/drivers/imu/bosch/bmi160/Kconfig
```kconfig
menuconfig DRIVERS_IMU_BOSCH_BMI160
	bool "bosch bmi160"
	default n
	---help---
		Enable support for the Bosch BMI160 SPI IMU.
```

## src/systemcmds/aegis_busdiag/Kconfig
```kconfig
menuconfig SYSTEMCMDS_AEGIS_BUSDIAG
	bool "aegis_busdiag"
	default n
	depends on PLATFORM_NUTTX && BOARD_ARCHITECTURE = "cortex-m7" && DRIVERS_IMU_BOSCH_BMI088
	---help---
		Bench-only raw sensor bus diagnostics for the Aegis FC board.
```
